## helios-custom-build-cfs/build/conf/bblayers.conf
```bitbake
# POKY_BBLAYERS_CONF_VERSION is increased each time build/conf/bblayers.conf
# changes incompatibly
POKY_BBLAYERS_CONF_VERSION = "2"

BBPATH = "${TOPDIR}"
BBFILES ?= ""

BBLAYERS ?= " \
  /home/yaxsomo/Workspaces/Helios-Core-OS/poky/meta \
  /home/yaxsomo/Workspaces/Helios-Core-OS/poky/meta-poky \
  /home/yaxsomo/Workspaces/Helios-Core-OS/poky/meta-yocto-bsp \
  /home/yaxsomo/Workspaces/Helios-Core-OS/poky/meta-helios-splashscreen \
  /home/yaxsomo/Workspaces/Helios-Core-OS/poky/meta-openembedded/meta-oe \
  /home/yaxsomo/Workspaces/Helios-Core-OS/poky/meta-openembedded/meta-python \
  /home/yaxsomo/Workspaces/Helios-Core-OS/poky/meta-openembedded/meta-networking \
  /home/yaxsomo/Workspaces/Helios-Core-OS/poky/meta-openembedded/meta-multimedia \
  /home/yaxsomo/Workspaces/Helios-Core-OS/poky/meta-openembedded/meta-gnome \
  /home/yaxsomo/Workspaces/Helios-Core-OS/poky/meta-openembedded/meta-xfce \
  /home/yaxsomo/Workspaces/Helios-Core-OS/poky/meta-arm/meta-arm-toolchain \
  /home/yaxsomo/Workspaces/Helios-Core-OS/poky/meta-arm/meta-arm \
  /home/yaxsomo/Workspaces/Helios-Core-OS/poky/meta-ti/meta-ti-bsp \
  /home/yaxsomo/Workspaces/Helios-Core-OS/poky/meta-ti/meta-ti-extras \
  "
```
